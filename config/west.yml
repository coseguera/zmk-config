## config/west.yml
```yaml
manifest:
  remotes:
    - name: zmkfirmware
      url-base: https://github.com/zmkfirmware
  projects:
    - name: zmkfirmware
      revision: main
      import: app/west.yml
  self:
    path: config
```
